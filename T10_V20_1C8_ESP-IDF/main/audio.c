#include "audio.h"
#include "audio_clips.h"   // generated by tools/wav2c.py

#include "driver/dac_continuous.h"
#include "driver/gpio.h"
#include "freertos/FreeRTOS.h"
#include "freertos/task.h"
#include "freertos/queue.h"
#include "esp_log.h"

static const char *TAG = "audio";

static QueueHandle_t   s_queue;    // pending play requests (clip index)
static volatile bool   s_busy;

int audio_clip_count(void) { return AUDIO_CLIP_COUNT; }

const char *audio_clip_name(int index)
{
    return (index >= 0 && index < AUDIO_CLIP_COUNT) ? g_audio_clips[index].name : "";
}

// Play one clip on a FRESH DAC channel, then tear it down. dac_continuous is a
// streaming API -- reusing one channel for repeated one-shots leaks DMA
// descriptors (the loop never releases them), which exhausts the pool after ~9
// plays and wedges playback until reboot. Create/destroy per clip = clean pool
// every time. The setup cost is trivial for button-triggered playback.
static void play_clip(const audio_clip_t *c)
{
    dac_continuous_handle_t dac = NULL;
    dac_continuous_config_t cfg = {
        .chan_mask = DAC_CHANNEL_MASK_CH0,      // CH0 = GPIO25
        .desc_num  = 8,
        .buf_size  = 2048,
        .freq_hz   = AUDIO_SAMPLE_RATE,
        .offset    = 0,
        .clk_src   = DAC_DIGI_CLK_SRC_APLL,     // APLL divides down to 16 kHz
        .chan_mode = DAC_CHANNEL_MODE_SIMUL,
    };
    esp_err_t r = dac_continuous_new_channels(&cfg, &dac);
    if (r != ESP_OK) { ESP_LOGW(TAG, "new_channels %s", esp_err_to_name(r)); return; }

    int play_ms = (int)(c->len / (AUDIO_SAMPLE_RATE / 1000));   // clip duration
    dac_continuous_enable(dac);
    r = dac_continuous_write(dac, (uint8_t *)c->data, c->len, NULL, play_ms + 2000);
    if (r != ESP_OK) ESP_LOGW(TAG, "write %s", esp_err_to_name(r));
    vTaskDelay(pdMS_TO_TICKS(play_ms + 150));    // let it finish before teardown
    dac_continuous_disable(dac);
    dac_continuous_del_channels(dac);
}

static void audio_task(void *arg)
{
    (void)arg;
    gpio_reset_pin(GPIO_NUM_25);   // release LEDC (boot melody) so the DAC can use it
    int idx;
    while (xQueueReceive(s_queue, &idx, portMAX_DELAY)) {
        s_busy = true;
        if (idx >= 0 && idx < AUDIO_CLIP_COUNT) {
            const audio_clip_t *c = &g_audio_clips[idx];
            ESP_LOGI(TAG, "play '%s' (%u bytes)", c->name, (unsigned)c->len);
            play_clip(c);
        }
        s_busy = false;
    }
}

void audio_play(int index)
{
    if (index < 0 || index >= AUDIO_CLIP_COUNT) return;
    if (s_queue == NULL) {                        // lazy one-time setup
        s_queue = xQueueCreate(2, sizeof(int));
        xTaskCreate(audio_task, "audio", 4096, NULL, 6, NULL);
    }
    if (s_busy) return;                           // play once; ignore while playing
    xQueueSend(s_queue, &index, 0);
}
